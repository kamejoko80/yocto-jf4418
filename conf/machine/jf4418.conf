## conf/machine/jf4418.conf
```bitbake
#@TYPE: Machine
#@NAME: JF4418
#@DESCRIPTION: Jf4418 board

require conf/machine/include/tune-cortexa9.inc

KERNEL_IMAGETYPE = "uImage"

SERIAL_CONSOLE = "ttyAMA0 115200 vt100"

MACHINE_DISPLAY_WIDTH_PIXELS = "320"
MACHINE_DISPLAY_HEIGHT_PIXELS = "240"
MACHINE_DISPLAY_ORIENTATION = "0"
MACHINE_DISPLAY_PPI = "110"
MACHINE_FEATURES = "kernel26 apm alsa usbgadget usbhost vfat screen touchscreen"
PREFERRED_PROVIDER_virtual/kernel = "linux-jf4418"

IMAGE_FSTYPES ?= "tar.bz2"
UBI_VOLNAME = "rootfs"
```
